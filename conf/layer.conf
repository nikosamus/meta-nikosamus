## conf/layer.conf
```bitbake
# We have a conf and classes directory, add to BBPATH
BBPATH .= ":${LAYERDIR}"

# We have recipes-* directories, add to BBFILES
BBFILES += "${LAYERDIR}/recipes-*/*/*.bb \
            ${LAYERDIR}/recipes-*/*/*.bbappend"

BBFILE_COLLECTIONS += "meta-nikosamus"
BBFILE_PATTERN_meta-nikosamus = "^${LAYERDIR}/"
BBFILE_PRIORITY_meta-nikosamus = "6"

LAYERDEPENDS_meta-nikosamus = "core"
LAYERSERIES_COMPAT_meta-nikosamus = "scarthgap"
```
